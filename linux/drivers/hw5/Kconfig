## linux/drivers/hw5/Kconfig
```kconfig
menu "HW5 Driver"

config HW5_DRIVER
	tristate "Week5 homework driver"
	help
		This is an Week5 homework drvier
endmenu
```

## linux/drivers/keyring/Kconfig
```kconfig
menu "Kering Driver"

config KEYRING_DRIVER
	tristate "Homework Keyring Driver"
	help
		this is an homework keyring drvier

endmenu
```

## linux/drivers/shout/Kconfig
```kconfig
menu "Shout Driver"

config SHOUT_DRVIER
	tristate "Shout Driver"
	help
		this is an shout driver using QEMU semihosting
endmenu
```

## linux/drivers/uartout/Kconfig
```kconfig
menu "Uart Out Driver"

config UARTOUT_DRIVER
	tristate "Homework UartOut Drvier"
	help
		this this an driver with uartout
endmenu
```
